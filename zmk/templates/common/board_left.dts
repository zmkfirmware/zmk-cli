// This file was generated from a template. Edit it to match your keyboard.
// See https://zmk.dev/docs/development/new-shield for more instructions.

#include "${id}.dtsi"
#include "${id}_left-pinctrl.dtsi"

<%include file="kscan_split_left.dtsi" />
