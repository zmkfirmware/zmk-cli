<%inherit file="keymap.dtsi" />
<%block name="layers">
        default_layer {
            bindings = <
                &kp N1 &kp N2    &kp N3 &kp N4
                &kp A  &kp B     &kp C  &kp D
            >;
        };
</%block>
