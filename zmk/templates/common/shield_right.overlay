// This file was generated from a template. Edit it to match your keyboard.
// See https://zmk.dev/docs/development/hardware-integration/new-shield for more
// instructions.

#include "${id}.dtsi"

<%include file="kscan_split_right.dtsi" />
