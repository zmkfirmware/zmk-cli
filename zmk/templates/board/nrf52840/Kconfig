## zmk/templates/board/nrf52840/split/Kconfig.board
```kconfig
config BOARD_${id.upper()}_LEFT
    bool "${name} left"
    depends on SOC_NRF52840_QIAA

config BOARD_${id.upper()}_RIGHT
    bool "${name} right"
    depends on SOC_NRF52840_QIAA
```

## zmk/templates/board/nrf52840/split/Kconfig.defconfig
```kconfig
<%inherit file="board/nrf52840/Kconfig.defconfig" />

<%def name="guard()">BOARD_${id.upper()}_LEFT || BOARD_${id.upper()}_RIGHT</%def>

<%block name="before">
if BOARD_${id.upper()}_LEFT

config ZMK_KEYBOARD_NAME
    default "${shortname}"

config ZMK_SPLIT_ROLE_CENTRAL
    default y

endif # BOARD_${id.upper()}_LEFT

</%block>
```

## zmk/templates/board/nrf52840/unibody/Kconfig.defconfig
```kconfig
<%inherit file="board/nrf52840/Kconfig.defconfig" />

<%def name="guard()">BOARD_${id.upper()}</%def>

<%block name="inner">
config ZMK_KEYBOARD_NAME
    default "${shortname}"

</%block>
```

## zmk/templates/board/other/unibody/Kconfig.defconfig
```kconfig
<%inherit file="board/other/Kconfig.defconfig" />

<%def name="guard()">BOARD_${id.upper()}</%def>

<%block name="inner">
config ZMK_KEYBOARD_NAME
    default "${shortname}"

</%block>
```

## zmk/templates/shield/split/Kconfig.defconfig
```kconfig
if SHIELD_${id.upper()}_LEFT

config ZMK_KEYBOARD_NAME
    default "${shortname}"

config ZMK_SPLIT_ROLE_CENTRAL
    default y

endif # SHIELD_${id.upper()}_LEFT

if SHIELD_${id.upper()}_LEFT || SHIELD_${id.upper()}_RIGHT

config ZMK_SPLIT
    default y

endif # SHIELD_${id.upper()}_LEFT || SHIELD_${id.upper()}_RIGHT
```

## zmk/templates/shield/split/Kconfig.shield
```kconfig
config SHIELD_${id.upper()}_LEFT
    def_bool $(shields_list_contains,${id}_left)

config SHIELD_${id.upper()}_RIGHT
    def_bool $(shields_list_contains,${id}_right)
```

## zmk/templates/shield/unibody/Kconfig.defconfig
```kconfig
if SHIELD_${id.upper()}

config ZMK_KEYBOARD_NAME
    default "${shortname}"

endif # SHIELD_${id.upper()}
```
