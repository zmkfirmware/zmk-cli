<%inherit file="common/board.dts" />
<%block name="system_includes">
#include <nordic/nrf52840_qiaa.dtsi>
</%block>
<%block name="chosen">
    chosen {
        zephyr,code-partition = &code_partition;
        zephyr,console = &cdc_acm_uart;
        zephyr,sram = &sram0;
        zephyr,flash = &flash0;
        // Uncomment this if you enabled one of the "vddh" nodes below.
        // zmk,battery = &vbatt;
        zmk,kscan = &kscan;
        zmk,matrix_transform = &default_transform;
    };
</%block>
<%block name="kscan">
<%include file="common/kscan_split_common.dtsi" />
</%block>
<%block name="matrix_transform">
<%include file="common/matrix_transform_split.dtsi" />
</%block>
<%block name="nodes">
<%include file="board/nrf52840/common_inner.dtsi" />
</%block>
<%include file="board/nrf52840/common_outer.dtsi" />
