// This file was generated from a template. Edit it to match your board.
// See https://zmk.dev/docs/development/new-shield for more instructions.

#include "${board}.dtsi"
#include "${board}_left-pinctrl.dtsi"

&kscan {
    // Replace these comments with the GPIO pins in the matrix for the left side.
    // See https://zmk.dev/docs/development/new-shield#shield-overlays
    col-gpios
        = </* &gpio0 0 */ GPIO_ACTIVE_HIGH>
        , </* &gpio0 0 */ GPIO_ACTIVE_HIGH>
        ;
};
